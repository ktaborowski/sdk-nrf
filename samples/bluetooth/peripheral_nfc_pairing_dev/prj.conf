## CMakeLists.txt
```
#
# Copyright (c) 2020 Nordic Semiconductor
#
# SPDX-License-Identifier: LicenseRef-Nordic-5-Clause
#

cmake_minimum_required(VERSION 3.20.0)

find_package(Zephyr REQUIRED HINTS $ENV{ZEPHYR_BASE})
project(NONE)

string(TIMESTAMP BUILD_TIMESTAMP "%Y-%m-%d %H:%M:%S" UTC)
target_compile_definitions(app PRIVATE BUILD_TIMESTAMP="${BUILD_TIMESTAMP}")

# NORDIC SDK APP START
target_sources(app  PRIVATE 
  src/main.c
  src/advertising.c
)
target_sources_ifdef(CONFIG_BT_PAIRING_SECURITY_ENABLED app PRIVATE src/pairing.c)
# NORDIC SDK APP END
```

## Kconfig
```
#
# Copyright (c) 2020 Nordic Semiconductor
#
# SPDX-License-Identifier: LicenseRef-Nordic-5-Clause
#

menu "NFC Paring configuration"

config BT_PAIRING_SECURITY_ENABLED
	bool "Enable BLE security (pairing/bonding)"
	default y
	select BT_SMP
	select BT_SMP_APP_PAIRING_ACCEPT
	select BT_SETTINGS
	select SETTINGS
	select FLASH
	select FLASH_PAGE_LAYOUT
	select FLASH_MAP
	select ZMS if (SOC_FLASH_NRF_RRAM || SOC_FLASH_NRF_MRAM)
	select NVS if !(SOC_FLASH_NRF_RRAM || SOC_FLASH_NRF_MRAM)
	help
	  Enable BLE pairing and bonding for the NFC pairing peripheral sample.

choice NFC_TAG_CONNECTION_HANDOVER_ROLE
	prompt "Connection Handover Tag role"
	default NFC_TAG_CH_SELECTOR

config NFC_TAG_CH_SELECTOR
	bool "Connection Handover selector role"
	help
	  NFC Tag is Connection Handover selector device. The Handover Selector
	  is an NFC Forum Device that constructs and replies to a
	  Handover Select Message as a result of a previously received
	  Handover Request Message, or an NFC Tag Device that provides a
	  pre-set Handover Select Message for reading.For more details
	  check NFC Forum Connection Handover 1.5 2.2

config NFC_TAG_CH_REQUESTER
	bool "Connection Handover requester role"
	help
	  NFC Tag is Connection Handover requester device. The Handover Requester
	  is an NFC Forum Device that begins the Handover Protocol by issuing
	  a Handover Request Message to another NFC Forum Device. For more
	  details check NFC Forum Connection Handover 1.5 2.2.

endchoice

endmenu

menu "Zephyr Kernel"
source "Kconfig.zephyr"
endmenu
```

## sample.yaml
```
sample:
  description: Bluetooth Low Energy Peripheral NFC Pairing reference sample
  name: Bluetooth Low Energy Peripheral NFC Pairing reference
common:
  tags:
    - bluetooth
    - ci_build
    - sysbuild
    - ci_samples_bluetooth
tests:
  sample.bluetooth.peripheral_nfc_pairing:
    sysbuild: true
    integration_platforms:
      - nrf54l15dk/nrf54l15/cpuapp
    platform_allow:
      - nrf52840dk/nrf52840
      - nrf52dk/nrf52832
      - nrf5340dk/nrf5340/cpuapp
      - nrf5340dk/nrf5340/cpuapp/ns
      - nrf54l15dk/nrf54l05/cpuapp
      - nrf54l15dk/nrf54l10/cpuapp
      - nrf54l15dk/nrf54l15/cpuapp
      - nrf54l15dk/nrf54l15/cpuapp/ns
      - nrf54h20dk/nrf54h20/cpuapp
      - nrf54lm20dk/nrf54lm20a/cpuapp
      - nrf54lm20dk/nrf54lm20a/cpuapp/ns
  sample.bluetooth.peripheral_nfc_pairing.no_security:
    sysbuild: true
    extra_args: CONFIG_BT_PAIRING_SECURITY_ENABLED=n
    integration_platforms:
      - nrf54l15dk/nrf54l15/cpuapp
    platform_allow:
      - nrf52840dk/nrf52840
      - nrf52dk/nrf52832
      - nrf5340dk/nrf5340/cpuapp
      - nrf5340dk/nrf5340/cpuapp/ns
      - nrf54l15dk/nrf54l05/cpuapp
      - nrf54l15dk/nrf54l10/cpuapp
      - nrf54l15dk/nrf54l15/cpuapp
      - nrf54l15dk/nrf54l15/cpuapp/ns
      - nrf54h20dk/nrf54h20/cpuapp
      - nrf54lm20dk/nrf54lm20a/cpuapp
      - nrf54lm20dk/nrf54lm20a/cpuapp/ns
```

## prj.conf
```kconfig
#
# Copyright (c) 2026 Nordic Semiconductor ASA
#
# SPDX-License-Identifier: LicenseRef-Nordic-5-Clause
#

# General
CONFIG_NCS_SAMPLES_DEFAULTS=y
CONFIG_DK_LIBRARY=y

# Bluetooth
CONFIG_BT=y
CONFIG_BT_PERIPHERAL=y
CONFIG_BT_DEVICE_NAME="Nordic_NFC_pairing"
CONFIG_BT_MAX_CONN=1
CONFIG_BT_MAX_PAIRED=4

CONFIG_BT_DIS=y
CONFIG_BT_DIS_MANUF_NAME=y
CONFIG_BT_DIS_MANUF_NAME_STR="NordicSemiconductor"
CONFIG_BT_DIS_PNP=y
CONFIG_BT_DIS_PNP_VID_SRC=2
CONFIG_BT_DIS_PNP_VID=0x1915
CONFIG_BT_DIS_PNP_PID=0xEEEB
CONFIG_BT_DIS_PNP_VER=0x0100

# NFC
CONFIG_NFC_T4T_NRFXLIB=y
CONFIG_NFC_NDEF=y
CONFIG_NFC_NDEF_MSG=y
CONFIG_NFC_NDEF_RECORD=y
CONFIG_NFC_NDEF_LE_OOB_REC=y

# Allow legacy OOB pairing (TK) alongside LESC
CONFIG_BT_SMP_SC_PAIR_ONLY=n

# CONFIG_SYSTEM_WORKQUEUE_STACK_SIZE=2048
# CONFIG_MAIN_STACK_SIZE=3072
```

## src/main.c
```c
/*
 * Copyright (c) 2020 Nordic Semiconductor ASA
 *
 * SPDX-License-Identifier: LicenseRef-Nordic-5-Clause
 */
#include <zephyr/kernel.h>
#include <string.h>

#include <zephyr/bluetooth/bluetooth.h>
#include <zephyr/bluetooth/conn.h>
#include <zephyr/bluetooth/hci.h>
#include <common/bt_str.h>

#include <zephyr/settings/settings.h>

#include <dk_buttons_and_leds.h>

#include <nfc_t4t_lib.h>
#include <nfc/t4t/ndef_file.h>
#include <nfc/ndef/msg.h>
#include <nfc/ndef/le_oob_rec.h>

#include "advertising.h"
#if defined(CONFIG_BT_PAIRING_SECURITY_ENABLED)
#include "pairing.h"
#endif

#define CON_STATUS_LED DK_LED1
#define NFC_FIELD_LED  DK_LED2

#define NDEF_FILE_BUF_SIZE 256

static uint8_t ndef_file_buf[NDEF_FILE_BUF_SIZE];
static struct bt_le_oob oob_local;

static void nfc_callback(void *context, nfc_t4t_event_t event,
			 const uint8_t *data, size_t data_length, uint32_t flags)
{
	ARG_UNUSED(context);
	ARG_UNUSED(data);
	ARG_UNUSED(data_length);
	ARG_UNUSED(flags);

	switch (event) {
	case NFC_T4T_EVENT_FIELD_ON:
		printk("NFC: field ON\n");
		dk_set_led_on(NFC_FIELD_LED);
		break;
	case NFC_T4T_EVENT_FIELD_OFF:
		printk("NFC: field OFF\n");
		dk_set_led_off(NFC_FIELD_LED);
		break;
	case NFC_T4T_EVENT_NDEF_READ:
		printk("NFC: NDEF read\n");
		advertising_start();
		break;
	default:
		break;
	}
}

static int nfc_ndef_le_oob_encode(uint8_t *file_buf, size_t buf_size)
{
	int err;
	struct nfc_ndef_le_oob_rec_payload_desc rec_payload;

	memset(&rec_payload, 0, sizeof(rec_payload));
	rec_payload.addr = &oob_local.addr;
	rec_payload.local_name = bt_get_name();
	rec_payload.le_role = NFC_NDEF_LE_OOB_REC_LE_ROLE(
		NFC_NDEF_LE_OOB_REC_LE_ROLE_PERIPH_ONLY);
	rec_payload.appearance = NFC_NDEF_LE_OOB_REC_APPEARANCE(
		CONFIG_BT_DEVICE_APPEARANCE);
	rec_payload.flags = NFC_NDEF_LE_OOB_REC_FLAGS(BT_LE_AD_NO_BREDR);
#if defined(CONFIG_BT_PAIRING_SECURITY_ENABLED)
	rec_payload.le_sc_data = &oob_local.le_sc_data;
	rec_payload.tk_value = (uint8_t *)pairing_get_tk();
#endif

	printk("NFC: addr: %s\n", bt_addr_le_str(rec_payload.addr));
	printk("NFC: local_name: %s\n", rec_payload.local_name);
	printk("NFC: le_role: %d\n", *rec_payload.le_role);
	printk("NFC: appearance: %d\n", *rec_payload.appearance);
	printk("NFC: flags: %d\n", *rec_payload.flags);
	printk("NFC: le_sc_data confirm: %s\n", bt_hex(rec_payload.le_sc_data->c, sizeof(rec_payload.le_sc_data->c)));
	printk("NFC: le_sc_data random: %s\n", bt_hex(rec_payload.le_sc_data->r, sizeof(rec_payload.le_sc_data->r)));

	NFC_NDEF_MSG_DEF(nfc_le_oob_msg, 1);
	NFC_NDEF_LE_OOB_RECORD_DESC_DEF(nfc_le_oob_rec, 0, &rec_payload);

	err = nfc_ndef_msg_record_add(&NFC_NDEF_MSG(nfc_le_oob_msg),
				      &NFC_NDEF_LE_OOB_RECORD_DESC(nfc_le_oob_rec));
	if (err) {
		printk("NFC: ndef_msg_record_add failed %d\n", err);
		return err;
	}

	uint32_t msg_len = nfc_t4t_ndef_file_msg_size_get(buf_size);
	uint8_t *msg_buf = nfc_t4t_ndef_file_msg_get(file_buf);

	err = nfc_ndef_msg_encode(&NFC_NDEF_MSG(nfc_le_oob_msg), msg_buf, &msg_len);
	if (err) {
		printk("NFC: ndef_msg_encode failed %d\n", err);
		return err;
	}

	err = nfc_t4t_ndef_file_encode(file_buf, &msg_len);
	if (err) {
		printk("NFC: ndef_file_encode failed %d\n", err);
		return err;
	}
	return 0;
}

static void nfc_init(void)
{
	int err;

	err = nfc_t4t_setup(nfc_callback, NULL);
	if (err) {
		printk("NFC: nfc_t4t_setup failed %d\n", err);
		return;
	}

	err = nfc_ndef_le_oob_encode(ndef_file_buf, sizeof(ndef_file_buf));
	if (err) {
		printk("NFC: ndef encode failed %d\n", err);
		return;
	}

	err = nfc_t4t_ndef_rwpayload_set(ndef_file_buf, sizeof(ndef_file_buf));
	if (err) {
		printk("NFC: nfc_t4t_ndef_rwpayload_set failed %d\n", err);
		return;
	}

	err = nfc_t4t_emulation_start();
	if (err) {
		printk("NFC: nfc_t4t_emulation_start failed %d\n", err);
		return;
	}

	printk("NFC initialized\n");
}

static void connected(struct bt_conn *conn, uint8_t err)
{
	char addr[BT_ADDR_LE_STR_LEN];

	bt_addr_le_to_str(bt_conn_get_dst(conn), addr, sizeof(addr));

	if (err) {
		printk("Connection failed %s 0x%02x %s\n", addr, err,
		       bt_hci_err_to_str(err));
		return;
	}

	printk("Connected %s\n", addr);
	dk_set_led_on(CON_STATUS_LED);
}

static void disconnected(struct bt_conn *conn, uint8_t reason)
{
	char addr[BT_ADDR_LE_STR_LEN];

	bt_addr_le_to_str(bt_conn_get_dst(conn), addr, sizeof(addr));
	dk_set_led_off(CON_STATUS_LED);
	printk("Disconnected %s, reason 0x%02x %s\n", addr, reason,
	       bt_hci_err_to_str(reason));
}

static void recycled_cb(void)
{
	advertising_start();
}

#if defined(CONFIG_BT_PAIRING_SECURITY_ENABLED)
static void security_changed(struct bt_conn *conn, bt_security_t level,
			     enum bt_security_err err)
{
	char addr[BT_ADDR_LE_STR_LEN];

	bt_addr_le_to_str(bt_conn_get_dst(conn), addr, sizeof(addr));

	if (!err) {
		printk("Security changed: %s level %u\n", addr, level);
	} else {
		printk("Security failed: %s level %u err %d %s\n", addr, level, err,
		       bt_security_err_to_str(err));
	}
}
#endif

BT_CONN_CB_DEFINE(conn_callbacks) = {
	.connected = connected,
	.disconnected = disconnected,
	.recycled = recycled_cb,
#if defined(CONFIG_BT_PAIRING_SECURITY_ENABLED)
	.security_changed = security_changed,
#endif
};

int main(void)
{
	int err;

	printk("Starting Bluetooth LE peripheral\n");
	printk("Build time" BUILD_TIMESTAMP "\n");

	err = dk_leds_init();
	if (err) {
		printk("LED init failed (err %d)\n", err);
		return 0;
	}

#if defined(CONFIG_BT_PAIRING_SECURITY_ENABLED)
	err = pairing_register();
	if (err) {
		printk("Failed to register pairing callbacks (err %d)\n", err);
		return 0;
	}
#endif

	err = bt_enable(NULL);
	if (err) {
		printk("Bluetooth init failed (err %d)\n", err);
		return 0;
	}

	printk("Bluetooth initialized\n");

#if defined(CONFIG_BT_PAIRING_SECURITY_ENABLED)
	err = settings_load();
	if (err) {
		printk("Cannot load settings (err %d)\n", err);
	}
#endif

#if defined(CONFIG_BT_PAIRING_SECURITY_ENABLED)
	err = paring_key_generate(&oob_local);
	if (err) {
		printk("Failed to generate pairing keys (err %d)\n", err);
		return 0;
	}
#else
	err = bt_le_oob_get_local(BT_ID_DEFAULT, &oob_local);
	if (err) {
		printk("Failed to get local OOB data (err %d)\n", err);
		return 0;
	}
#endif /* CONFIG_BT_PAIRING_SECURITY_ENABLED */

	advertising_init();

	nfc_init();

	for (;;) {
		k_sleep(K_SECONDS(1));
	}
}
```

## src/advertising.c
```c
/*
 * Copyright (c) 2020 Nordic Semiconductor ASA
 *
 * SPDX-License-Identifier: LicenseRef-Nordic-5-Clause
 */
#include <zephyr/kernel.h>

#include <zephyr/bluetooth/bluetooth.h>

#define DEVICE_NAME CONFIG_BT_DEVICE_NAME
#define DEVICE_NAME_LEN (sizeof(DEVICE_NAME) - 1)

static struct k_work adv_work;

static const struct bt_data ad[] = {
	BT_DATA(BT_DATA_NAME_COMPLETE, DEVICE_NAME, DEVICE_NAME_LEN),
	BT_DATA_BYTES(BT_DATA_FLAGS, (BT_LE_AD_GENERAL | BT_LE_AD_NO_BREDR)),
};

static void adv_work_handler(struct k_work *work)
{
	int err = bt_le_adv_start(BT_LE_ADV_CONN_FAST_2, ad, ARRAY_SIZE(ad), NULL, 0);

	if (err && err != -EALREADY) {
		printk("Advertising failed to start (err %d)\n", err);
		return;
	}
	if (!err) {
		printk("Advertising started\n");
	}
}

void advertising_start(void)
{
	k_work_submit(&adv_work);
}

void advertising_init(void)
{
	k_work_init(&adv_work, adv_work_handler);
}
```

## src/advertising.h
```c
/*
 * Copyright (c) 2020 Nordic Semiconductor ASA
 *
 * SPDX-License-Identifier: LicenseRef-Nordic-5-Clause
 */

#ifndef ADVERTISING_H__
#define ADVERTISING_H__

/** Start connectable advertising (via work queue). */
void advertising_start(void);

/** Initialize advertising (work + first start). Call after bt_enable. */
void advertising_init(void);

#endif /* ADVERTISING_H__ */
```

## src/pairing.c
```c
/*
 * Copyright (c) 2020 Nordic Semiconductor ASA
 *
 * SPDX-License-Identifier: LicenseRef-Nordic-5-Clause
 */
#include <zephyr/kernel.h>
#include <zephyr/bluetooth/conn.h>
#include <common/bt_str.h>
#include <nfc/ndef/le_oob_rec.h>

#include "pairing.h"

#define AUTH_SC_FLAG 0x08

static struct bt_le_oob *oob_local_ptr;
static uint8_t tk_value[NFC_NDEF_LE_OOB_REC_TK_LEN];

static void auth_cancel(struct bt_conn *conn)
{
	char addr[BT_ADDR_LE_STR_LEN];

	bt_addr_le_to_str(bt_conn_get_dst(conn), addr, sizeof(addr));

	printk("Pairing cancelled: %s\n", addr);
}

static void auth_oob_data_request(struct bt_conn *conn, struct bt_conn_oob_info *info)
{
	int err;
	struct bt_conn_info conn_info;
	char addr[BT_ADDR_LE_STR_LEN];

	printk("Auth OOB data request type: %d\n", info->type);

	if (!oob_local_ptr) {
		printk("Auth failed: No local OOB data\n");
		return;
	}

	if (info->type == BT_CONN_OOB_LE_SC) {
		err = bt_conn_get_info(conn, &conn_info);
		if (err) {
			printk("Auth failed: Failed to get connection info: %d\n", err);
			return;
		}

		if (bt_addr_le_cmp(conn_info.le.local, &oob_local_ptr->addr)) {
			bt_addr_le_to_str(conn_info.le.local, addr, sizeof(addr));
			printk("Auth failed: No OOB data available for local %s", addr);
			bt_conn_auth_cancel(conn);
			return;
		}

		if (bt_addr_le_cmp(conn_info.le.local, &oob_local_ptr->addr)) {
			printk("Auth failed: Local addr mismatch for LESC OOB\n");
			bt_conn_auth_cancel(conn);
			return;
		}
		err = bt_le_oob_set_sc_data(conn, &oob_local_ptr->le_sc_data, NULL);
		if (err) {
			printk("Auth failed: LESC OOB set error: %d\n", err);
		}
		return;
	}

#if !defined(CONFIG_BT_SMP_SC_PAIR_ONLY)
	if (info->type == BT_CONN_OOB_LE_LEGACY) {
		printk("Legacy TK value requested\n");
		err = bt_le_oob_set_legacy_tk(conn, tk_value);
		if (err) {
			printk("TK value set error: %d\n", err);
		}
		return;
	}
#endif

	printk("Auth failed: Unsupported OOB type %u\n", info->type);
}

static enum bt_security_err pairing_accept(struct bt_conn *conn,
					   const struct bt_conn_pairing_feat *feat)
{
	if (feat->oob_data_flag && (!(feat->auth_req & AUTH_SC_FLAG))) {
		bt_le_oob_set_legacy_flag(true);
	}
	return BT_SECURITY_ERR_SUCCESS;
}

static void pairing_complete(struct bt_conn *conn, bool bonded)
{
	char addr[BT_ADDR_LE_STR_LEN];

	bt_addr_le_to_str(bt_conn_get_dst(conn), addr, sizeof(addr));

	printk("Pairing completed: %s, bonded: %d\n", addr, bonded);
	bt_le_oob_set_sc_flag(false);
#if !defined(CONFIG_BT_SMP_SC_PAIR_ONLY)
	bt_le_oob_set_legacy_flag(false);
#endif
}

static void pairing_failed(struct bt_conn *conn, enum bt_security_err reason)
{
	char addr[BT_ADDR_LE_STR_LEN];

	bt_addr_le_to_str(bt_conn_get_dst(conn), addr, sizeof(addr));

	printk("Pairing failed conn: %s, reason %d %s\n", addr, reason,
	       bt_security_err_to_str(reason));
	bt_le_oob_set_sc_flag(false);
#if !defined(CONFIG_BT_SMP_SC_PAIR_ONLY)
	bt_le_oob_set_legacy_flag(false);
#endif
}

static struct bt_conn_auth_cb conn_auth_callbacks = {
	.cancel = auth_cancel,
	.oob_data_request = auth_oob_data_request,
	.pairing_accept = pairing_accept,
};

static struct bt_conn_auth_info_cb conn_auth_info_callbacks = {
	.pairing_complete = pairing_complete,
	.pairing_failed = pairing_failed,
};

int pairing_register(void)
{
	int err;

	err = bt_conn_auth_cb_register(&conn_auth_callbacks);
	if (err) {
		return err;
	}

	err = bt_conn_auth_info_cb_register(&conn_auth_info_callbacks);
	if (err) {
		return err;
	}

	return 0;
}

int paring_key_generate(struct bt_le_oob *oob)
{
	int err;

	printk("Generating new pairing keys\n");

#if !defined(CONFIG_BT_SMP_SC_PAIR_ONLY)
	err = bt_rand(tk_value, sizeof(tk_value));

	if (err) {
		printk("Random TK value generation failed: %d\n", err);
	}
#endif
	err = bt_le_oob_get_local(BT_ID_DEFAULT, oob);
	oob_local_ptr = err ? NULL : oob;

	if (!err) {
		bt_le_oob_set_sc_flag(true);
	}

	return err;
}

const uint8_t *pairing_get_tk(void)
{
	return tk_value;
}
```

## src/pairing.h
```c
/*
 * Copyright (c) 2020 Nordic Semiconductor ASA
 *
 * SPDX-License-Identifier: LicenseRef-Nordic-5-Clause
 */

#ifndef PAIRING_H__
#define PAIRING_H__

#include <zephyr/bluetooth/bluetooth.h>

int pairing_register(void);

int paring_key_generate(struct bt_le_oob *oob);

const uint8_t *pairing_get_tk(void);

#endif /* PAIRING_H__ */
```
