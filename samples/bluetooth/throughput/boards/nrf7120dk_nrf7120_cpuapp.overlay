/*
 * Copyright (c) 2026 Nordic Semiconductor ASA
 *
 * SPDX-License-Identifier: LicenseRef-Nordic-5-Clause
 */

/* Report a higher sleep clock accuracy to the BLE controller than the
 * default, to work around connection drops caused by higher than expected
 * LF clock drift.
 */
&lfclk {
	k32src = "xtal";
	k32src-accuracy-ppm = <500>;
};

/* The DK buttons are on gpio4, which is missing the gpiote-instance property
 * that its siblings gpio1 and gpio3 have. Without it, GPIO interrupts return
 * -ENOTSUP and dk_buttons_init() fails.
 */
&gpio4 {
	gpiote-instance = <&gpiote20>;
};

/* Replaces app.overlay, which targets uart0; this board uses uart20. */
&uart20 {
	/delete-property/ hw-flow-control;
};
