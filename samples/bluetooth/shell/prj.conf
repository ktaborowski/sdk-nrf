## CMakeLists.txt
```
#
# Copyright (c) 2024 Nordic Semiconductor ASA
#
# SPDX-License-Identifier: LicenseRef-Nordic-5-Clause
#
cmake_minimum_required(VERSION 3.20.0)

find_package(Zephyr REQUIRED HINTS $ENV{ZEPHYR_BASE})
project(bluetooth_shell)

target_sources(app PRIVATE src/main.c)
target_sources_ifdef(CONFIG_BT_GATT_DM app PRIVATE src/shell_gatt_dm.c)
target_sources_ifdef(CONFIG_BT_EXT_ADV app PRIVATE src/shell_multiple_adv.c)
```

## sample.yaml
```
sample:
  description: Bluetooth Shell sample, demonstrates Bluetooth
    shell commands
  name: Bluetooth Shell
tests:
  sample.bluetooth.shell:
    sysbuild: true
    integration_platforms:
      - nrf52840dk/nrf52840
      - nrf54l15dk/nrf54l15/cpuapp
    platform_allow:
      - nrf52840dk/nrf52840
      - nrf54l15dk/nrf54l15/cpuapp
    tags:
      - bluetooth
    harness: console
    harness_config:
      type: multi_line
      ordered: true
      regex:
        - "uart:~"
    timeout: 30
  sample.bluetooth.shell.basic:
    sysbuild: true
    harness: shell
    harness_config:
      shell_commands_file: test_shell_basic.yml
    integration_platforms:
      - nrf52840dk/nrf52840
      - nrf54l15dk/nrf54l15/cpuapp
    platform_allow:
      - nrf52840dk/nrf52840
      - nrf54l15dk/nrf54l15/cpuapp
    tags:
      - bluetooth
      - shell
    timeout: 30
  sample.bluetooth.shell.gatt_dm:
    sysbuild: true
    harness: shell
    harness_config:
      shell_commands_file: test_shell_gatt_dm.yml
    integration_platforms:
      - nrf52840dk/nrf52840
      - nrf54l15dk/nrf54l15/cpuapp
    platform_allow:
      - nrf52840dk/nrf52840
      - nrf54l15dk/nrf54l15/cpuapp
    tags:
      - bluetooth
      - shell
      - discovery_manager
    timeout: 30
  sample.bluetooth.shell.multi_adv:
    sysbuild: true
    harness: shell
    harness_config:
      shell_commands_file: test_shell_multi_adv.yml
    integration_platforms:
      - nrf52840dk/nrf52840
      - nrf54l15dk/nrf54l15/cpuapp
    platform_allow:
      - nrf52840dk/nrf52840
      - nrf54l15dk/nrf54l15/cpuapp
    tags:
      - bluetooth
      - shell
      - multi_adv
    timeout: 60
```

## prj.conf
```kconfig
#
# Copyright (c) 2021 Nordic Semiconductor
#
# SPDX-License-Identifier: LicenseRef-Nordic-5-Clause
#

CONFIG_BT=y
CONFIG_BT_CENTRAL=y
CONFIG_BT_PERIPHERAL=y
CONFIG_BT_GATT_CLIENT=y
CONFIG_BT_GATT_DYNAMIC_DB=y
CONFIG_BT_DEVICE_NAME="Bluetooth Shell"

CONFIG_SHELL=y
# BT Host Shell
CONFIG_BT_SHELL=y

CONFIG_LOG=y
CONFIG_REBOOT=y

# GATT Discovery Manager
CONFIG_BT_GATT_DM=y
CONFIG_BT_GATT_DM_DATA_PRINT=y
CONFIG_BT_GATT_DM_MAX_ATTRS=40
CONFIG_HEAP_MEM_POOL_SIZE=1024

CONFIG_BT_EXT_ADV=y
CONFIG_BT_EXT_ADV_MAX_ADV_SET=4
```

## src/main.c
```c
/*
 * Copyright (c) 2024 Nordic Semiconductor ASA
 *
 * SPDX-License-Identifier: LicenseRef-Nordic-5-Clause
 */

#include <stdio.h>

int main(void)
{
	printf("Hello World! %s\n", CONFIG_BOARD_TARGET);

	return 0;
}
```

## src/shell_gatt_dm.c
```c
/*
 * Copyright (c) 2024 Nordic Semiconductor ASA
 *
 * SPDX-License-Identifier: LicenseRef-Nordic-5-Clause
 */

#include <zephyr/types.h>
#include <stddef.h>
#include <stdlib.h>
#include <string.h>
#include <errno.h>
#include <zephyr/shell/shell.h>
#include <zephyr/bluetooth/bluetooth.h>
#include <zephyr/bluetooth/conn.h>
#include <zephyr/bluetooth/uuid.h>
#include <bluetooth/gatt_dm.h>

/* Connection lookup context */
struct conn_lookup_ctx {
	struct bt_conn *conn;
	uint8_t target_idx;
	uint8_t current_idx;
};

/* Discovery state */
static struct {
	bool discovery_in_progress;
	bool is_discover_all; /* true if discover-all, false if discover-uuid */
	struct bt_conn *current_conn;
	struct bt_gatt_dm *current_dm;
} discovery_state;

/* Callback context for connection lookup */
static void conn_lookup_by_index(struct bt_conn *conn, void *user_data)
{
	struct conn_lookup_ctx *ctx = user_data;
	struct bt_conn_info info;

	if (bt_conn_get_info(conn, &info) != 0) {
		return;
	}

	if (info.state != BT_CONN_STATE_CONNECTED) {
		return;
	}

	if (ctx->current_idx == ctx->target_idx) {
		ctx->conn = bt_conn_ref(conn);
	}

	ctx->current_idx++;
}

/* Get connection by index (0-based) */
static struct bt_conn *get_conn_by_index(uint8_t idx)
{
	struct conn_lookup_ctx ctx = {
		.conn = NULL,
		.target_idx = idx,
		.current_idx = 0,
	};

	bt_conn_foreach(BT_CONN_TYPE_LE, conn_lookup_by_index, &ctx);

	return ctx.conn;
}

/* Get default connection from BT shell */
static struct bt_conn *get_default_conn(void)
{
	struct conn_lookup_ctx ctx = {
		.conn = NULL,
		.target_idx = 0,
		.current_idx = 0,
	};

	/* Get first connected LE connection */
	bt_conn_foreach(BT_CONN_TYPE_LE, conn_lookup_by_index, &ctx);

	return ctx.conn;
}

/* Discovery completion callback */
static void discovery_completed_cb(struct bt_gatt_dm *dm, void *context)
{
	char uuid_str[37];
	const struct bt_gatt_dm_attr *gatt_service_attr;
	const struct bt_gatt_service_val *gatt_service;
	size_t attr_count;

	gatt_service_attr = bt_gatt_dm_service_get(dm);
	if (!gatt_service_attr) {
		shell_error((const struct shell *)context, "Failed to get service");
		return;
	}

	gatt_service = bt_gatt_dm_attr_service_val(gatt_service_attr);
	if (!gatt_service) {
		shell_error((const struct shell *)context, "Failed to get service value");
		return;
	}

	attr_count = bt_gatt_dm_attr_cnt(dm);
	bt_uuid_to_str(gatt_service->uuid, uuid_str, sizeof(uuid_str));

	shell_print((const struct shell *)context, "Discovery completed:");
	shell_print((const struct shell *)context, "  Service UUID: %s", uuid_str);
	shell_print((const struct shell *)context, "  Attribute count: %zu", attr_count);

	bt_gatt_dm_data_print(dm);
	
	/* Store DM instance for release/continue commands */
	discovery_state.current_dm = dm;
	
	shell_print((const struct shell *)context, "Use 'gatt-dm continue' to find next service or 'gatt-dm release' to finish");
}

static void discovery_service_not_found_cb(struct bt_conn *conn, void *context)
{
	ARG_UNUSED(conn);

	shell_print((const struct shell *)context, "No more services found");
	discovery_state.discovery_in_progress = false;
	discovery_state.is_discover_all = false;
	if (discovery_state.current_conn) {
		bt_conn_unref(discovery_state.current_conn);
		discovery_state.current_conn = NULL;
	}
	discovery_state.current_dm = NULL;
}

static void discovery_error_cb(struct bt_conn *conn, int err, void *context)
{
	ARG_UNUSED(conn);

	shell_error((const struct shell *)context, "Discovery failed: %d", err);
	discovery_state.discovery_in_progress = false;
	discovery_state.is_discover_all = false;
	if (discovery_state.current_conn) {
		bt_conn_unref(discovery_state.current_conn);
		discovery_state.current_conn = NULL;
	}
	discovery_state.current_dm = NULL;
}

static struct bt_gatt_dm_cb discovery_cb = {
	.completed = discovery_completed_cb,
	.service_not_found = discovery_service_not_found_cb,
	.error_found = discovery_error_cb,
};

/* Shell command: discover-all */
static int cmd_gatt_dm_discover_all(const struct shell *sh, size_t argc, char **argv)
{
	struct bt_conn *conn = NULL;
	int err;
	uint8_t conn_idx = 0;

	if (discovery_state.discovery_in_progress) {
		shell_error(sh, "Discovery already in progress");
		return -EALREADY;
	}

	/* Get connection */
	if (argc > 1) {
		conn_idx = strtoul(argv[1], NULL, 10);
		conn = get_conn_by_index(conn_idx);
		if (!conn) {
			shell_error(sh, "Connection index %u not found", conn_idx);
			return -ENOENT;
		}
	} else {
		conn = get_default_conn();
		if (!conn) {
			shell_error(sh, "No connection available. Connect first or specify connection index");
			return -ENOENT;
		}
	}

	if (argc > 1) {
		shell_print(sh, "Starting discovery on connection %u", conn_idx);
	} else {
		shell_print(sh, "Starting discovery on default connection");
	}

	err = bt_gatt_dm_start(conn, NULL, &discovery_cb, (void *)sh);
	if (err) {
		shell_error(sh, "Failed to start discovery: %d", err);
		bt_conn_unref(conn);
		return err;
	}

	discovery_state.discovery_in_progress = true;
	discovery_state.is_discover_all = true;
	discovery_state.current_conn = conn;
	discovery_state.current_dm = NULL;

	return 0;
}

/* Shell command: discover-uuid */
static int cmd_gatt_dm_discover_uuid(const struct shell *sh, size_t argc, char **argv)
{
	struct bt_conn *conn = NULL;
	struct bt_uuid_16 uuid16;
	struct bt_uuid *uuid = NULL;
	int err;
	uint8_t conn_idx = 0;
	unsigned long uuid_val;
	char *endptr;

	if (discovery_state.discovery_in_progress) {
		shell_error(sh, "Discovery already in progress");
		return -EALREADY;
	}

	if (argc < 2) {
		shell_error(sh, "UUID required");
		shell_help(sh);
		return -EINVAL;
	}

	/* Parse UUID */
	if (strncmp(argv[1], "0x", 2) == 0 || strncmp(argv[1], "0X", 2) == 0) {
		uuid_val = strtoul(argv[1], &endptr, 16);
	} else {
		uuid_val = strtoul(argv[1], &endptr, 16);
	}

	if (*endptr != '\0' || uuid_val == 0 || uuid_val > UINT16_MAX) {
		shell_error(sh, "Invalid UUID format. Use 16-bit UUID (e.g., 0x180F)");
		return -EINVAL;
	}

	/* Initialize UUID structure */
	uuid16.uuid.type = BT_UUID_TYPE_16;
	uuid16.val = (uint16_t)uuid_val;
	uuid = (struct bt_uuid *)&uuid16;

	/* Get connection */
	if (argc > 2) {
		conn_idx = strtoul(argv[2], NULL, 10);
		conn = get_conn_by_index(conn_idx);
		if (!conn) {
			shell_error(sh, "Connection index %u not found", conn_idx);
			return -ENOENT;
		}
	} else {
		conn = get_default_conn();
		if (!conn) {
			shell_error(sh, "No connection available. Connect first or specify connection index");
			return -ENOENT;
		}
	}

	if (argc > 2) {
		shell_print(sh, "Starting discovery for UUID 0x%04X on connection %u",
			    uuid16.val, conn_idx);
	} else {
		shell_print(sh, "Starting discovery for UUID 0x%04X on default connection",
			    uuid16.val);
	}

	err = bt_gatt_dm_start(conn, uuid, &discovery_cb, (void *)sh);
	if (err) {
		shell_error(sh, "Failed to start discovery: %d", err);
		bt_conn_unref(conn);
		return err;
	}

	discovery_state.discovery_in_progress = true;
	discovery_state.is_discover_all = false;
	discovery_state.current_conn = conn;
	discovery_state.current_dm = NULL;

	return 0;
}

/* Shell command: continue */
static int cmd_gatt_dm_continue(const struct shell *sh, size_t argc, char **argv)
{
	int err;

	ARG_UNUSED(argc);
	ARG_UNUSED(argv);

	if (!discovery_state.discovery_in_progress || !discovery_state.current_dm) {
		shell_error(sh, "No discovery in progress or discovery data not available. Start discovery first");
		return -EINVAL;
	}

	if (!discovery_state.is_discover_all) {
		shell_error(sh, "Continue only works with 'discover-all', not 'discover-uuid'");
		return -EINVAL;
	}

	/* Release previous discovery data before continuing */
	err = bt_gatt_dm_data_release(discovery_state.current_dm);
	if (err && err != -EALREADY) {
		shell_error(sh, "Failed to release discovery data: %d", err);
		return err;
	}

	shell_print(sh, "Continuing discovery...");

	err = bt_gatt_dm_continue(discovery_state.current_dm, (void *)sh);
	if (err) {
		shell_error(sh, "Failed to continue discovery: %d", err);
		return err;
	}

	discovery_state.current_dm = NULL;

	return 0;
}

/* Shell command: release */
static int cmd_gatt_dm_release(const struct shell *sh, size_t argc, char **argv)
{
	int err;

	ARG_UNUSED(argc);
	ARG_UNUSED(argv);

	if (!discovery_state.discovery_in_progress) {
		shell_error(sh, "No discovery in progress");
		return -EINVAL;
	}

	if (discovery_state.current_dm) {
		err = bt_gatt_dm_data_release(discovery_state.current_dm);
		if (err && err != -EALREADY) {
			shell_error(sh, "Failed to release discovery data: %d", err);
			return err;
		}
		discovery_state.current_dm = NULL;
	}

	discovery_state.discovery_in_progress = false;

	if (discovery_state.current_conn) {
		bt_conn_unref(discovery_state.current_conn);
		discovery_state.current_conn = NULL;
	}

	shell_print(sh, "Discovery data released");

	return 0;
}

SHELL_STATIC_SUBCMD_SET_CREATE(gatt_dm_cmds,
	SHELL_CMD_ARG(discover-all, NULL,
		      "[conn_idx]",
		      cmd_gatt_dm_discover_all, 1, 1),
	SHELL_CMD_ARG(discover-uuid, NULL,
		      "<uuid> [conn_idx]",
		      cmd_gatt_dm_discover_uuid, 2, 1),
	SHELL_CMD_ARG(continue, NULL,
		      NULL,
		      cmd_gatt_dm_continue, 1, 0),
	SHELL_CMD_ARG(release, NULL,
		      NULL,
		      cmd_gatt_dm_release, 1, 0),
	SHELL_SUBCMD_SET_END
);

SHELL_CMD_REGISTER(gatt_dm, &gatt_dm_cmds, "GATT Discovery Manager commands", NULL);
```

## src/shell_multiple_adv.c
```c
/*
 * Copyright (c) 2024 Nordic Semiconductor ASA
 *
 * SPDX-License-Identifier: LicenseRef-Nordic-5-Clause
 */

#include <zephyr/types.h>
#include <stddef.h>
#include <stdlib.h>
#include <string.h>
#include <errno.h>
#include <zephyr/shell/shell.h>
#include <zephyr/bluetooth/bluetooth.h>
#include <zephyr/bluetooth/gap.h>
#include <zephyr/bluetooth/addr.h>
#include <zephyr/bluetooth/conn.h>
#include <zephyr/sys/printk.h>
#include <zephyr/sys/util.h>

#if defined(CONFIG_BT_EXT_ADV)

/* Advertising set state */
enum adv_set_state {
	ADV_SET_STATE_NOT_CREATED,
	ADV_SET_STATE_CREATED,
	ADV_SET_STATE_STARTED,
};

/* Advertising set information */
struct adv_set_info {
	struct bt_le_ext_adv *adv;
	enum adv_set_state state;
	uint8_t sid;
};

/* Advertising sets state */
static struct adv_set_info adv_sets_info[CONFIG_BT_EXT_ADV_MAX_ADV_SET];

/* Callbacks for advertising events */
#if defined(CONFIG_BT_PERIPHERAL)
static void adv_connected_cb(struct bt_le_ext_adv *adv,
			     struct bt_le_ext_adv_connected_info *info)
{
	char addr[BT_ADDR_LE_STR_LEN];
	uint8_t idx = bt_le_ext_adv_get_index(adv);

	bt_addr_le_to_str(bt_conn_get_dst(info->conn), addr, sizeof(addr));
	printk("Advertiser[%d] %p connected conn %p (%s)\n",
	       idx, adv, info->conn, addr);
}
#endif /* CONFIG_BT_PERIPHERAL */

static void adv_scanned_cb(struct bt_le_ext_adv *adv,
			   struct bt_le_ext_adv_scanned_info *info)
{
	char addr[BT_ADDR_LE_STR_LEN];
	uint8_t idx = bt_le_ext_adv_get_index(adv);

	bt_addr_le_to_str(info->addr, addr, sizeof(addr));
	printk("Advertiser[%d] scanned by %s\n", idx, addr);
}

static void adv_sent_cb(struct bt_le_ext_adv *adv,
			struct bt_le_ext_adv_sent_info *info)
{
	uint8_t idx = bt_le_ext_adv_get_index(adv);

	printk("Advertiser[%d] sent %d events\n",
	       idx, info->num_sent);
}

static const struct bt_le_ext_adv_cb adv_cb = {
#if defined(CONFIG_BT_PERIPHERAL)
	.connected = adv_connected_cb,
#endif /* CONFIG_BT_PERIPHERAL */
	.scanned = adv_scanned_cb,
	.sent = adv_sent_cb,
};

/* Get advertising set info by index */
static struct adv_set_info *get_adv_set_info(uint8_t idx)
{
	if (idx >= ARRAY_SIZE(adv_sets_info)) {
		return NULL;
	}

	return &adv_sets_info[idx];
}

/* Parse advertising options */
static int parse_adv_options(const struct shell *sh, size_t argc, char **argv,
			     struct bt_le_adv_param *param, uint8_t default_sid)
{
	bool connectable = false;
	bool scannable = false;
	bool non_connectable = false;
	int interval_min = -1;
	int interval_max = -1;

	/* Default parameters */
	param->id = BT_ID_DEFAULT;
	param->options = BT_LE_ADV_OPT_EXT_ADV;
	param->interval_min = BT_GAP_ADV_FAST_INT_MIN_2;
	param->interval_max = BT_GAP_ADV_FAST_INT_MAX_2;
	param->peer = NULL;
	param->sid = default_sid;

	for (size_t i = 0; i < argc; i++) {
		if (!strcmp(argv[i], "connectable")) {
			connectable = true;
			param->options |= BT_LE_ADV_OPT_CONN;
		} else if (!strcmp(argv[i], "non-connectable")) {
			non_connectable = true;
		} else if (!strcmp(argv[i], "scannable")) {
			scannable = true;
			param->options |= BT_LE_ADV_OPT_SCANNABLE;
		} else if (!strcmp(argv[i], "interval-min")) {
			if (i + 1 >= argc) {
				shell_error(sh, "interval-min requires a value");
				return -EINVAL;
			}
			interval_min = strtol(argv[++i], NULL, 10);
			if (interval_min <= 0 || interval_min > 0xFFFF) {
				shell_error(sh, "Invalid interval-min: %d", interval_min);
				return -EINVAL;
			}
			param->interval_min = interval_min;
		} else if (!strcmp(argv[i], "interval-max")) {
			if (i + 1 >= argc) {
				shell_error(sh, "interval-max requires a value");
				return -EINVAL;
			}
			interval_max = strtol(argv[++i], NULL, 10);
			if (interval_max <= 0 || interval_max > 0xFFFF) {
				shell_error(sh, "Invalid interval-max: %d", interval_max);
				return -EINVAL;
			}
			param->interval_max = interval_max;
		} else if (!strcmp(argv[i], "sid")) {
			if (i + 1 >= argc) {
				shell_error(sh, "sid requires a value");
				return -EINVAL;
			}
			int sid = strtol(argv[++i], NULL, 10);
			if (sid < 0 || sid > 0xF) {
				shell_error(sh, "Invalid sid: %d (must be 0-15)", sid);
				return -EINVAL;
			}
			param->sid = sid;
		}
	}

	if (connectable && non_connectable) {
		shell_error(sh, "Cannot specify both connectable and non-connectable");
		return -EINVAL;
	}

	if (interval_max > 0 && interval_min > 0 && interval_max < interval_min) {
		shell_error(sh, "interval-max must be >= interval-min");
		return -EINVAL;
	}

	return 0;
}

/* Shell command: create */
static int cmd_multi_adv_create(const struct shell *sh, size_t argc, char **argv)
{
	struct bt_le_adv_param param;
	struct adv_set_info *set_info;
	uint8_t idx;
	int err;

	if (argc < 2) {
		shell_error(sh, "Index required");
		shell_help(sh);
		return -EINVAL;
	}

	idx = strtoul(argv[1], NULL, 10);
	if (idx >= ARRAY_SIZE(adv_sets_info)) {
		shell_error(sh, "Invalid index: %u (max: %zu)", idx,
			    ARRAY_SIZE(adv_sets_info) - 1);
		return -EINVAL;
	}

	set_info = get_adv_set_info(idx);
	if (set_info->state != ADV_SET_STATE_NOT_CREATED) {
		shell_error(sh, "Advertiser[%d] already exists. Delete it first", idx);
		return -EALREADY;
	}

	/* Parse options */
	if (argc > 2) {
		err = parse_adv_options(sh, argc - 2, &argv[2], &param, idx);
		if (err) {
			return err;
		}
	} else {
		/* Default: non-connectable, scannable */
		param.id = BT_ID_DEFAULT;
		param.options = BT_LE_ADV_OPT_EXT_ADV | BT_LE_ADV_OPT_SCANNABLE;
		param.interval_min = BT_GAP_ADV_FAST_INT_MIN_2;
		param.interval_max = BT_GAP_ADV_FAST_INT_MAX_2;
		param.peer = NULL;
		param.sid = idx;
	}

	/* Create advertising set */
	err = bt_le_ext_adv_create(&param, &adv_cb, &set_info->adv);
	if (err) {
		shell_error(sh, "Failed to create advertiser[%d]: %d", idx, err);
		return err;
	}

	set_info->state = ADV_SET_STATE_CREATED;
	set_info->sid = param.sid;

	shell_print(sh, "Created advertiser[%d] (SID: %d)", idx, param.sid);

	return 0;
}

/* Shell command: data */
static int cmd_multi_adv_data(const struct shell *sh, size_t argc, char **argv)
{
	struct adv_set_info *set_info;
	uint8_t idx;
	int err;
	struct bt_data ad[BT_GAP_ADV_MAX_ADV_DATA_LEN];
	size_t ad_len = 0;
	struct bt_data sd[BT_GAP_ADV_MAX_ADV_DATA_LEN];
	size_t sd_len = 0;
	bool is_scan_response = false;

	if (argc < 3) {
		shell_error(sh, "Index and data required");
		shell_help(sh);
		return -EINVAL;
	}

	idx = strtoul(argv[1], NULL, 10);
	if (idx >= ARRAY_SIZE(adv_sets_info)) {
		shell_error(sh, "Invalid index: %u", idx);
		return -EINVAL;
	}

	set_info = get_adv_set_info(idx);
	if (set_info->state == ADV_SET_STATE_NOT_CREATED) {
		shell_error(sh, "Advertiser[%d] not created. Create it first", idx);
		return -EINVAL;
	}

	/* Parse arguments */
	for (size_t i = 2; i < argc; i++) {
		if (!strcmp(argv[i], "scan-response")) {
			is_scan_response = true;
			continue;
		} else if (!strcmp(argv[i], "name")) {
			if (i + 1 >= argc) {
				shell_error(sh, "name requires a value");
				return -EINVAL;
			}
			const char *name = argv[++i];
			size_t name_len = strlen(name);

			if (is_scan_response) {
				if (sd_len >= ARRAY_SIZE(sd)) {
					shell_error(sh, "Too many scan response data entries");
					return -ENOMEM;
				}
				sd[sd_len].type = BT_DATA_NAME_COMPLETE;
				sd[sd_len].data_len = name_len;
				sd[sd_len].data = (const uint8_t *)name;
				sd_len++;
			} else {
				if (ad_len >= ARRAY_SIZE(ad)) {
					shell_error(sh, "Too many advertising data entries");
					return -ENOMEM;
				}
				ad[ad_len].type = BT_DATA_NAME_COMPLETE;
				ad[ad_len].data_len = name_len;
				ad[ad_len].data = (const uint8_t *)name;
				ad_len++;
			}
		} else if (!strcmp(argv[i], "flags")) {
			uint8_t flags = BT_LE_AD_NO_BREDR;

			if (is_scan_response) {
				if (sd_len >= ARRAY_SIZE(sd)) {
					shell_error(sh, "Too many scan response data entries");
					return -ENOMEM;
				}
				sd[sd_len].type = BT_DATA_FLAGS;
				sd[sd_len].data_len = 1;
				sd[sd_len].data = &flags;
				sd_len++;
			} else {
				if (ad_len >= ARRAY_SIZE(ad)) {
					shell_error(sh, "Too many advertising data entries");
					return -ENOMEM;
				}
				ad[ad_len].type = BT_DATA_FLAGS;
				ad[ad_len].data_len = 1;
				ad[ad_len].data = &flags;
				ad_len++;
			}
		} else {
			/* Try to parse as hex data */
			shell_error(sh, "Unsupported data format: %s", argv[i]);
			shell_help(sh);
			return -EINVAL;
		}
	}

	/* Set advertising data */
	err = bt_le_ext_adv_set_data(set_info->adv, ad_len > 0 ? ad : NULL, ad_len,
				      sd_len > 0 ? sd : NULL, sd_len);
	if (err) {
		shell_error(sh, "Failed to set data for advertiser[%d]: %d", idx, err);
		return err;
	}

	shell_print(sh, "Set data for advertiser[%d]", idx);

	return 0;
}

/* Shell command: start */
static int cmd_multi_adv_start(const struct shell *sh, size_t argc, char **argv)
{
	struct adv_set_info *set_info;
	struct bt_le_ext_adv_start_param start_param = {0};
	uint8_t idx;
	int err;
	int timeout = 0;
	int num_events = 0;

	if (argc < 2) {
		shell_error(sh, "Index required");
		shell_help(sh);
		return -EINVAL;
	}

	idx = strtoul(argv[1], NULL, 10);
	if (idx >= ARRAY_SIZE(adv_sets_info)) {
		shell_error(sh, "Invalid index: %u", idx);
		return -EINVAL;
	}

	set_info = get_adv_set_info(idx);
	if (set_info->state == ADV_SET_STATE_NOT_CREATED) {
		shell_error(sh, "Advertiser[%d] not created. Create it first", idx);
		return -EINVAL;
	}

	if (set_info->state == ADV_SET_STATE_STARTED) {
		shell_print(sh, "Advertiser[%d] already started", idx);
		return 0;
	}

	/* Parse optional parameters */
	for (size_t i = 2; i < argc; i++) {
		if (!strcmp(argv[i], "timeout")) {
			if (i + 1 >= argc) {
				shell_error(sh, "timeout requires a value");
				return -EINVAL;
			}
			timeout = strtol(argv[++i], NULL, 10);
			if (timeout < 0 || timeout > 0xFFFF) {
				shell_error(sh, "Invalid timeout: %d", timeout);
				return -EINVAL;
			}
			start_param.timeout = timeout;
		} else if (!strcmp(argv[i], "num-events")) {
			if (i + 1 >= argc) {
				shell_error(sh, "num-events requires a value");
				return -EINVAL;
			}
			num_events = strtol(argv[++i], NULL, 10);
			if (num_events < 0 || num_events > 0xFF) {
				shell_error(sh, "Invalid num-events: %d", num_events);
				return -EINVAL;
			}
			start_param.num_events = num_events;
		}
	}

	err = bt_le_ext_adv_start(set_info->adv,
				  timeout > 0 || num_events > 0 ? &start_param : NULL);
	if (err) {
		shell_error(sh, "Failed to start advertiser[%d]: %d", idx, err);
		return err;
	}

	set_info->state = ADV_SET_STATE_STARTED;
	shell_print(sh, "Started advertiser[%d]", idx);

	return 0;
}

/* Shell command: stop */
static int cmd_multi_adv_stop(const struct shell *sh, size_t argc, char **argv)
{
	struct adv_set_info *set_info;
	uint8_t idx;
	int err;

	if (argc < 2) {
		shell_error(sh, "Index required");
		shell_help(sh);
		return -EINVAL;
	}

	idx = strtoul(argv[1], NULL, 10);
	if (idx >= ARRAY_SIZE(adv_sets_info)) {
		shell_error(sh, "Invalid index: %u", idx);
		return -EINVAL;
	}

	set_info = get_adv_set_info(idx);
	if (set_info->state == ADV_SET_STATE_NOT_CREATED) {
		shell_error(sh, "Advertiser[%d] not created", idx);
		return -EINVAL;
	}

	if (set_info->state != ADV_SET_STATE_STARTED) {
		shell_print(sh, "Advertiser[%d] not started", idx);
		return 0;
	}

	err = bt_le_ext_adv_stop(set_info->adv);
	if (err) {
		shell_error(sh, "Failed to stop advertiser[%d]: %d", idx, err);
		return err;
	}

	set_info->state = ADV_SET_STATE_CREATED;
	shell_print(sh, "Stopped advertiser[%d]", idx);

	return 0;
}

/* Shell command: delete */
static int cmd_multi_adv_delete(const struct shell *sh, size_t argc, char **argv)
{
	struct adv_set_info *set_info;
	uint8_t idx;
	int err;

	if (argc < 2) {
		shell_error(sh, "Index required");
		shell_help(sh);
		return -EINVAL;
	}

	idx = strtoul(argv[1], NULL, 10);
	if (idx >= ARRAY_SIZE(adv_sets_info)) {
		shell_error(sh, "Invalid index: %u", idx);
		return -EINVAL;
	}

	set_info = get_adv_set_info(idx);
	if (set_info->state == ADV_SET_STATE_NOT_CREATED) {
		shell_error(sh, "Advertiser[%d] not created", idx);
		return -EINVAL;
	}

	/* Stop if started */
	if (set_info->state == ADV_SET_STATE_STARTED) {
		bt_le_ext_adv_stop(set_info->adv);
	}

	err = bt_le_ext_adv_delete(set_info->adv);
	if (err) {
		shell_error(sh, "Failed to delete advertiser[%d]: %d", idx, err);
		return err;
	}

	set_info->adv = NULL;
	set_info->state = ADV_SET_STATE_NOT_CREATED;
	set_info->sid = 0;

	shell_print(sh, "Deleted advertiser[%d]", idx);

	return 0;
}

/* Shell command: list */
static int cmd_multi_adv_list(const struct shell *sh, size_t argc, char **argv)
{
	ARG_UNUSED(argc);
	ARG_UNUSED(argv);

	shell_print(sh, "Advertising sets:");
	shell_print(sh, "Index | State      | SID");
	shell_print(sh, "------|------------|-----");

	for (size_t i = 0; i < ARRAY_SIZE(adv_sets_info); i++) {
		const struct adv_set_info *set_info = &adv_sets_info[i];
		const char *state_str;

		switch (set_info->state) {
		case ADV_SET_STATE_NOT_CREATED:
			state_str = "not created";
			break;
		case ADV_SET_STATE_CREATED:
			state_str = "created";
			break;
		case ADV_SET_STATE_STARTED:
			state_str = "started";
			break;
		default:
			state_str = "unknown";
			break;
		}

		if (set_info->state != ADV_SET_STATE_NOT_CREATED) {
			shell_print(sh, "  %zu   | %-10s | %d", i, state_str, set_info->sid);
		}
	}

	return 0;
}

/* Shell command: start-all */
static int cmd_multi_adv_start_all(const struct shell *sh, size_t argc, char **argv)
{
	ARG_UNUSED(argc);
	ARG_UNUSED(argv);

	int err;
	int started = 0;
	int failed = 0;

	for (size_t i = 0; i < ARRAY_SIZE(adv_sets_info); i++) {
		struct adv_set_info *set_info = &adv_sets_info[i];

		if (set_info->state == ADV_SET_STATE_CREATED) {
			err = bt_le_ext_adv_start(set_info->adv, NULL);
			if (err) {
				shell_error(sh, "Failed to start advertiser[%zu]: %d", i, err);
				failed++;
			} else {
				set_info->state = ADV_SET_STATE_STARTED;
				started++;
			}
		}
	}

	if (started > 0) {
		shell_print(sh, "Started %d advertiser(s)", started);
	}

	if (failed > 0) {
		shell_error(sh, "Failed to start %d advertiser(s)", failed);
		return -EIO;
	}

	if (started == 0) {
		shell_print(sh, "No created advertisers to start");
	}

	return 0;
}

/* Shell command: stop-all */
static int cmd_multi_adv_stop_all(const struct shell *sh, size_t argc, char **argv)
{
	ARG_UNUSED(argc);
	ARG_UNUSED(argv);

	int err;
	int stopped = 0;
	int failed = 0;

	for (size_t i = 0; i < ARRAY_SIZE(adv_sets_info); i++) {
		struct adv_set_info *set_info = &adv_sets_info[i];

		if (set_info->state == ADV_SET_STATE_STARTED) {
			err = bt_le_ext_adv_stop(set_info->adv);
			if (err) {
				shell_error(sh, "Failed to stop advertiser[%zu]: %d", i, err);
				failed++;
			} else {
				set_info->state = ADV_SET_STATE_CREATED;
				stopped++;
			}
		}
	}

	if (stopped > 0) {
		shell_print(sh, "Stopped %d advertiser(s)", stopped);
	}

	if (failed > 0) {
		shell_error(sh, "Failed to stop %d advertiser(s)", failed);
		return -EIO;
	}

	if (stopped == 0) {
		shell_print(sh, "No started advertisers to stop");
	}

	return 0;
}

SHELL_STATIC_SUBCMD_SET_CREATE(multi_adv_cmds,
	SHELL_CMD_ARG(create, NULL,
		      "<index> [connectable|non-connectable] [scannable] "
		      "[interval-min <ms>] [interval-max <ms>] [sid <id>]",
		      cmd_multi_adv_create, 2, 10),
	SHELL_CMD_ARG(data, NULL,
		      "<index> [name <name>] [flags] [scan-response ...]",
		      cmd_multi_adv_data, 3, 10),
	SHELL_CMD_ARG(start, NULL,
		      "<index> [timeout <ms>] [num-events <count>]",
		      cmd_multi_adv_start, 2, 4),
	SHELL_CMD_ARG(stop, NULL,
		      "<index>",
		      cmd_multi_adv_stop, 2, 0),
	SHELL_CMD_ARG(delete, NULL,
		      "<index>",
		      cmd_multi_adv_delete, 2, 0),
	SHELL_CMD_ARG(list, NULL,
		      NULL,
		      cmd_multi_adv_list, 1, 0),
	SHELL_CMD_ARG(start-all, NULL,
		      NULL,
		      cmd_multi_adv_start_all, 1, 0),
	SHELL_CMD_ARG(stop-all, NULL,
		      NULL,
		      cmd_multi_adv_stop_all, 1, 0),
	SHELL_SUBCMD_SET_END
);

SHELL_CMD_REGISTER(multi_adv, &multi_adv_cmds, "Multiple advertising sets commands", NULL);

#endif /* CONFIG_BT_EXT_ADV */
```
