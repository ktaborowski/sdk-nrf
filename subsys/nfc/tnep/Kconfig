## subsys/nfc/tnep/Kconfig
```kconfig
#
# Copyright (c) 2017 Nordic Semiconductor ASA
#
# SPDX-License-Identifier: LicenseRef-BSD-5-Clause-Nordic
#

config NFC_TNEP_TAG
	bool
	prompt "Tag NDEF Exchange Protocol The NFC Tag Device."

config NFC_TNEP_POLLER
	bool
	prompt "Tag NDEF Exchange Protocol The Reader/Wrter Device."
```
